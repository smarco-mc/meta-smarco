## conf/layer.conf
```bitbake
# We have a conf and classes directory, add to BBPATH
BBPATH =. "${LAYERDIR}:"

# We have recipes-* directories, add to BBFILES
BBFILES += "${LAYERDIR}/recipes-*/*/*.bb \
            ${LAYERDIR}/recipes-*/*/*.bbappend"

BBFILE_COLLECTIONS += "meta-smarco"
BBFILE_PATTERN_meta-smarco = "^${LAYERDIR}/"
BBFILE_PRIORITY_meta-smarco = "8"

# This should only be incremented on significant changes that will
# cause compatibility issues with other layers
LAYERVERSION_meta-smarco = "1"

LAYERDEPENDS_meta-smarco = "core"

LAYERSERIES_COMPAT_meta-smarco = "kirkstone"
```

## conf/machine/duowen.conf
```bitbake
#@TYPE: Machine
#@NAME: duowen
#@SOC: Smart Core DUOWEN
#@DESCRIPTION: Machine configuration for the DUOWEN development board

DEFAULTTUNE ?= "smarco-vaisra"
require conf/machine/include/riscv/tune-smarco.inc

MACHINE_FEATURES = "screen keyboard ext2 ext3 serial alsa pci usbhost vfat"

KERNEL_IMAGETYPE = "Image.gz"

PREFERRED_PROVIDER_virtual/kernel ?= "linux-mainline"
PREFERRED_PROVIDER_virtual/bootloader ?= "u-boot"

EXTRA_IMAGEDEPENDS += "opensbi"
RISCV_SBI_PLAT = "generic"

RISCV_SBI_FDT ?=  "duowen.dtb"

SERIAL_CONSOLES = "115200;ttyS0 115200;hvc0"
SERIAL_CONSOLES_CHECK = "${SERIAL_CONSOLES}"

MACHINE_EXTRA_RRECOMMENDS += " kernel-modules"

IMAGE_FSTYPES += "wic.xz ext4 tar.xz"
KERNEL_DEVICETREE ?= "smarco/${RISCV_SBI_FDT}"

## Do not update fstab file when using wic images
#WIC_CREATE_EXTRA_ARGS ?= "--no-fstab-update"

EXTRA_IMAGEDEPENDS += "u-boot"
UBOOT_MACHINE = "duowen_fsbl_defconfig"

# U-Boot SPL
SPL_BINARY ?= "spl/u-boot-spl.bin"

# U-Boot ITB (FIT image with U-Boot S-mode, OpenSBI FW_DYNAMIC, DTB [from
# U-Boot source code tree])
UBOOT_SUFFIX ?= "itb"

## wic default support
WKS_FILE_DEPENDS ?= " \
    opensbi \
    e2fsprogs-native \
    bmap-tools-native \
"

IMAGE_BOOT_FILES ?= " \
    Image.gz-initramfs-duowen.bin \
    duowen.dtb \
"

WKS_FILE ?= "duowen-spl-opensbi.wks"

BAD_RECOMMENDATIONS += "\
    libcxx-dev \
    libcxx-staticdev \
    compiler-rt-dev \
    compiler-rt-staticdev \
"
ASSUME_PROVIDED += "\
    libcxx-dev \
    libcxx-staticdev \
    compiler-rt-dev \
    compiler-rt-staticdev \
"

INITRAMFS_IMAGE = "demo-coreip-cli-initramfs"
INITRAMFS_IMAGE_BUNDLE = "1"
# INITRAMFS_MAXSIZE ="15728640"
INITRAMFS_FSTYPES = "cpio.gz"
```

## conf/machine/include/riscv/tune-smarco.inc
```bitbake
require conf/machine/include/riscv/tune-riscv.inc

TUNEVALID[smarco-ariane] = "SmarCo ARIANE Cores"
TUNEVALID[smarco-vaisra] = "SmarCo VAISRA Cores"

AVAILTUNES += " smarco-ariane smarco-vaisra"

# SmarCo ARIANE Cores
TUNE_FEATURES:tune-smarco-ariane = "${TUNE_FEATURES:tune-riscv64} smarco-ariane"
TUNE_ARCH:tune-smarco-ariane = "riscv64"
TUNE_PKGARCH:tune-smarco-ariane = "riscv64"
PACKAGE_EXTRA_ARCHS:tune-smarco-ariane = "riscv64"
TUNE_CCARGS_MARCH:tune-smarco-ariane .= "${@bb.utils.contains('TUNE_FEATURES', 'riscv64', ' -march=rv64gc', '', d)}"

# Smarco VAISRA Cores
TUNE_FEATURES:tune-smarco-vaisra = "${TUNE_FEATURES:tune-riscv64} smarco-vaisra"
TUNE_ARCH:tune-smarco-vaisra = "riscv64"
TUNE_PKGARCH:tune-smarco-vaisra = "riscv64"
PACKAGE_EXTRA_ARCHS:tune-smarco-vaisra = "riscv64"
TUNE_CCARGS_MARCH:tune-smarco-ariane .= "${@bb.utils.contains('TUNE_FEATURES', 'riscv64', ' -march=rv64g', '', d)}"

#TUNE_CCARGS:append = "${@bb.utils.contains('TUNE_FEATURES', 'smarco-ariane', ' -mtune=smarco-ariane', ' ', d)}"
#TUNE_CCARGS:append = "${@bb.utils.contains('TUNE_FEATURES', 'smarco-vaisra', ' -mtune=smarco-vaisra', ' ', d)}"
```
